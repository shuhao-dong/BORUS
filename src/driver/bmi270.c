#include "bmi270.h"
#include <zephyr/kernel.h>
#include <zephyr/drivers/spi.h>
#include <zephyr/sys/printk.h>
#include <zephyr/logging/log.h>
#include <math.h>
#include <zephyr/sys/__assert.h>
#include <zephyr/sys/byteorder.h>
#include <zephyr/drivers/sensor.h>

#define BMI270_WR_LEN   256
#define BMI270_INTER_WRITE_DELAY_US     1000

LOG_MODULE_REGISTER(BMI270, LOG_LEVEL_DBG); 

const uint8_t bmi270_config_file[] = {
    0xc8, 0x2e, 0x00, 0x2e, 0x80, 0x2e, 0x3d, 0xb1, 0xc8, 0x2e, 0x00, 0x2e, 0x80, 0x2e, 0x91, 0x03, 0x80, 0x2e, 0xbc,
    0xb0, 0x80, 0x2e, 0xa3, 0x03, 0xc8, 0x2e, 0x00, 0x2e, 0x80, 0x2e, 0x00, 0xb0, 0x50, 0x30, 0x21, 0x2e, 0x59, 0xf5,
    0x10, 0x30, 0x21, 0x2e, 0x6a, 0xf5, 0x80, 0x2e, 0x3b, 0x03, 0x00, 0x00, 0x00, 0x00, 0x08, 0x19, 0x01, 0x00, 0x22,
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    0x2e, 0x00, 0xc1
};

bmi270_pwr_config_t bmi270_normal_mode = {
    .gyr_filter_perf = 1,
    .gyr_noise_perf = 0,
    .high_perf_en = 1,
};

bmi270_pwr_config_t bmi270_performance_mode = {
    .gyr_filter_perf = 1,
    .gyr_noise_perf = 1,
    .high_perf_en = 1,
};

bmi270_pwr_config_t bmi270_low_power_mode = {
    .gyr_filter_perf = 0,
    .gyr_noise_perf = 0,
    .high_perf_en = 0,
}; 


/**
 * @brief Helper function to read a value from a register
 * 
 * Read a value from a register of BMI270. Notice that BMI270 SDO data has additional dummy byte
 * 
 * @param ctx Pointer to a BMI270 sensor context
 * @param reg Starting register address
 * @param data Buffer array where data will be saved to
 * @param size Number of bytes to read (exclude dummy bytes)
 * 
 * @return 0 if successfully, error code otherwise
 */
static int bmi270_reg_read(BMI270_Context *ctx, uint8_t reg, uint8_t *data, uint8_t len) {
    int err;

    /* Set the register address with the read bit */
    uint8_t tx_buffer = reg | 0x80;   // Set MSB to indicate a read operation
    uint8_t rx_dummy[2];              // Dummy byte buffer (For BMI270, this is two, check other sensors)

    /* Set up transmit buffer for register address */
    struct spi_buf tx_spi_buf = {
        .buf = &tx_buffer,
        .len = 1
    };
    struct spi_buf_set tx_spi_buf_set = {
        .buffers = &tx_spi_buf,
        .count = 1
    };

    /* Set up receive buffers */
    struct spi_buf rx_spi_bufs[2] = {
        {.buf = &rx_dummy, .len = 2},   // Dummy byte buffer
        {.buf = data, .len = len}      // Actual data buffer
    };
    struct spi_buf_set rx_spi_buf_set = {
        .buffers = rx_spi_bufs,
        .count = ARRAY_SIZE(rx_spi_bufs)
    };

    /* Perform the SPI transaction */
    err = spi_transceive_dt(ctx->spec, &tx_spi_buf_set, &rx_spi_buf_set);
    if (err < 0) {
        LOG_ERR("spi_transceive_dt() failed, err: %d", err);
        return err;
    }

    /* Add a short delay for device stabilization */
    k_usleep(2);

    return 0;
}

/**
 * @brief Helper function to write a value to registers
 * 
 * Write values to registers of BMI270
 * 
 * @param ctx Pointer to a BMI270 sensor context
 * @param start Start address of the register to read
 * @param data Buffer array to store the value to be written
 * @param len Number of bytes to write
 * 
 * @return 0 if successful, error code otherwise
 */
static int bmi270_reg_write(BMI270_Context *ctx, uint8_t start, const uint8_t *data, uint16_t len){
	int ret;

    /* Set the bit to write command - bit7 is 0 */
	uint8_t addr = start & 0x7F;

    /* Prepare the write buffer, with first element being the command, second element being the value */
	const struct spi_buf tx_buf[2] = {
		{.buf = &addr, .len = sizeof(addr)},
		{.buf = (uint8_t *)data, .len = len}
	};
	const struct spi_buf_set tx = {
		.buffers = tx_buf,
		.count = ARRAY_SIZE(tx_buf)
	};

	ret = spi_write_dt(ctx->spec, &tx);
	if (ret < 0) {
		LOG_ERR("spi_write_dt failed %i", ret);
		return ret;
	}

	k_usleep(2);
    
	return 0;
}

/**
 * @brief Write to a register with delay afterwards
 * 
 * Share the same input/output with bmi270_reg_write
 */
static int bmi270_reg_write_with_delay(BMI270_Context *ctx, uint8_t start, const uint8_t *data, uint16_t len, uint32_t delay_us){
    int ret = 0;

    ret = bmi270_reg_write(ctx, start, data, len);
    if (ret == 0){
        k_usleep(delay_us);
    }
    return ret; 
}

/**
 * @brief Write specific command to BMI270
 * 
 * @param ctx A pointer to a BMI270 sensor context
 * @param cmd A command for cmd register
 * 
 * @retval 0 if successful, err otherwise
 */
int bmi270_write_command(BMI270_Context *ctx, BMI270_cmd *cmd){
    int ret = 0;

    ret = bmi270_reg_write(ctx, BMI270_REG_CMD, cmd, 1);
    if (ret != 0){
        LOG_ERR("Failed to write command 0x%02X", *cmd);
    }
    LOG_DBG("Write command 0x%02X", *cmd); 
    return ret;
}

/**
 * @brief Write initial configuration file
 */
static int8_t write_config_file(BMI270_Context *ctx){
	int8_t ret = 0;
	uint16_t index = 0;
	uint8_t addr_array[2] = { 0 };

	LOG_DBG("writing config file");

	/* Disable loading of the configuration */
	for (index = 0; index < sizeof(bmi270_config_file); index += BMI270_WR_LEN) {
		/* Store 0 to 3 bits of address in first byte */
		addr_array[0] = (uint8_t)((index / 2) & 0x0F);

		/* Store 4 to 11 bits of address in the second byte */
		addr_array[1] = (uint8_t)((index / 2) >> 4);

		ret = bmi270_reg_write_with_delay(ctx, BMI270_REG_INIT_ADDR_0, addr_array, 2, BMI270_INTER_WRITE_DELAY_US);

		if (ret == 0) {
			ret = bmi270_reg_write_with_delay(ctx,
						BMI270_REG_INIT_DATA,
						&bmi270_config_file[index],
						BMI270_WR_LEN,
						BMI270_INTER_WRITE_DELAY_US);
		} else {
            LOG_ERR("Config file upload failed"); 
        }
	}

	return ret;
}

/**
 * @brief Helper function to configure sensor to SPI mode
 * 
 * Configure sensor to SPI mode by single read a random register to pull CS high
 * 
 * @param ctx Pointer to a BMI270 sensor context 
 * 
 * @return 0 if successfull
 */
static int bmi270_use_spi(BMI270_Context *ctx){
    int ret;
    uint8_t values;
    ret = bmi270_reg_read(ctx, BMI270_REG_CHIP_ID, &values, sizeof(values)); 
    if (ret != 0){
        LOG_ERR("Failed to configure BMI270 to SPI mode (err: %d)", ret);
        return ret;
    }
    return 0; 
}

/**
 * @brief Helper function to set FIFO watermark level
 * 
 * Configure FIFO water mark level. Max value is 8191
 * 
 * @param ctx Pointer to a BMI270 sensor context
 * @param watermark Watermark level
 * 
 * @return 0 if successful
 */
static int bmi270_conf_fifo_watermark(BMI270_Context *ctx, uint16_t watermark){
    int ret = 0;
    uint8_t tx_bufs[2];

    if (watermark > (0x1F * 256 + 0xFF)){
        LOG_ERR("FIFO watermark level overflow: maximum allowed is 8191");
        return -1; 
    }

    tx_bufs[0] = watermark & 0xFF;
    tx_bufs[1] = (watermark >> 8) & 0x1F;

    ret = bmi270_reg_write(ctx, BMI270_REG_FIFO_WTM_0, tx_bufs, sizeof(tx_bufs)); 
    if (ret != 0){
        LOG_ERR("Failed to configure FIFO watermark level");
        return ret;
    }
    return 0; 
}

/**
 * @brief Helper function to enable/disable sensor components
 * 
 * Choose to enable/disable acc, gyr, temp and aux for BMI270
 * 
 * @param ctx A pointer to a BMI270 sensor context
 * @param acc_enable Flag to enable accelerometer
 * @param gyr_enable Flag to enable gyroscope
 * @param aux_enable Flag to enable auxiliary sensor 
 * @param temp_enable Flag o enble die temperature sensor
 * 
 * @return 0 if successful, err code otherwise
 */
static int bmi270_enable_sensor(BMI270_Context *ctx, 
        bool acc_enable, bool gyr_enable, bool aux_enable, bool temp_enable)
{
    int ret = 0;
    uint8_t sensor_enable = (aux_enable | 
                        (gyr_enable << 1) |
                        (acc_enable << 2) |
                        (temp_enable << 3)); 
    ret = bmi270_reg_write(ctx, BMI270_REG_PWR_CTRL, &sensor_enable, sizeof(sensor_enable)); 
    if (ret != 0){
        LOG_ERR("Failed to enable sensors");
        return ret; 
    }
    return 0; 
}

/**
 * @brief Helper function to configure power profile for the sensor
 * 
 * @param ctx A pointer to a BMI270 sensor context
 * @param config Power configuration file
 * 
 * @retval 0 if successful, err otherwise  
 */
static int bmi270_conf_pwr(BMI270_Context *ctx, bmi270_pwr_config_t *config){
    int ret = 0;
    
    uint8_t acc_conf, gyr_conf;
    acc_conf = ((config->high_perf_en) << 7);
    gyr_conf = ((config->gyr_filter_perf) << 7) | ((config->gyr_noise_perf) << 6);

    ret = bmi270_reg_write(ctx, BMI270_REG_ACC_CONF, &acc_conf, sizeof(acc_conf));
    if (ret != 0){
        LOG_ERR("Failed to configure acc power mode");
        return ret;
    }

    ret = bmi270_reg_write(ctx, BMI270_REG_GYR_CONF, &gyr_conf, sizeof(gyr_conf));
    if (ret != 0){
        LOG_ERR("Failed to configure gyr power mode");
        return ret;
    }

    return 0; 
}

/**
 * @brief Convert raw acceleration value to m^2/s
 * 
 * @param val An array to save the converted values
 * @param raw_value Raw acc values obtained from the register
 * @param range Configured acceleration measurement range
 * 
 */
static void bmi270_acc_convert_raw(struct sensor_value *val, int64_t raw_value, uint8_t range){
    /* Convert from raw value to m^2/s */
    raw_value = (raw_value * SENSOR_G * (int64_t)range) / INT16_MAX;
    val->val1 = raw_value / 1000000LL;
    val->val2 = raw_value % 1000000LL;
}

/**
 * @brief Convert raw gyroscope value to rad/s
 * 
 * @param val An array to save the converted values
 * @param raw_value Raw gyr values obtained from the register
 * @param range Configured gyroscope measurement range 
 */
static void bmi270_gyr_convert_raw(struct sensor_value *val, int64_t raw_value, uint16_t range){
    /* Convert from degrees/s to rad/s */
    raw_value = (raw_value * SENSOR_PI * (int64_t)range) / (180LL * INT16_MAX); 
    val->val1 = raw_value / 1000000LL;
    val->val2 = raw_value % 1000000LL; 
}

/* ------------------------------------------------------------------------------------------------------------------- */

int bmi270_lock_spi_interface(BMI270_Context *ctx)
{
    uint8_t nv;
    int ret;

    /* 1. Read current value ----------------------------------------- */
    ret = bmi270_reg_read(ctx, BMI270_REG_NV_CONF, &nv, 1);
    if (ret) {
        LOG_ERR("NV_CONF read failed (%d)", ret);
        return ret;
    }

    /* 2. If already set, nothing to do ------------------------------ */
    if (nv & BMI270_NV_CONF_SPI_EN) {
        LOG_DBG("NV_CONF.spi_en already = 1 (0x%02X)", nv);
        return 0;
    }

    /* 3. Set bit 4 and write back ----------------------------------- */
    nv |= BMI270_NV_CONF_SPI_EN;

    ret = bmi270_reg_write(ctx, BMI270_REG_NV_CONF, &nv, 1);
    if (ret) {
        LOG_ERR("NV_CONF write failed (%d)", ret);
        return ret;
    }

    /* 4. Give the part a few µs to latch the new primary IF --------- */
    k_busy_wait(50);                    /* t_IF_SW = 40 ns min        */

    LOG_INF("BMI270 locked to SPI (NV_CONF = 0x%02X)", nv);
    return 0;
}

static int bmi270_soft_reset(BMI270_Context *ctx)
{
    uint8_t cmd = 0xB6;
    bmi270_reg_write(ctx, BMI270_REG_CMD, &cmd, 1);
    k_msleep(2);
    return 0; 
}

/**
 * @brief Initialise BMI270 sensor 
 * 
 * Initialise BMI270 sensor as suggested by the datasheet
 * 
 * @param ctx Pointer to a BMI270 sensor context
 * @param spec Pointer to a SPI bus used by the sensor
 * 
 * @return True if successful
 */
bool bmi270_init(BMI270_Context *ctx, const struct spi_dt_spec *spec){
    ctx->spec = spec; 
    int ret;
    uint8_t values;
    uint8_t tx_buf; 

    /* Interface selection - for SPI only */
    ret = bmi270_use_spi(ctx); 
    if (ret != 0){
        LOG_ERR("Failed to use SPI mode");
        return false;
    }

    ret = bmi270_soft_reset(ctx); 
    if (ret != 0) {
        LOG_ERR("Failed to reset");
        return false;
    }

    ret = bmi270_lock_spi_interface(ctx);
    if (ret) {
        LOG_ERR("Failed to lock SPI");
        return false; 
    }

    /* Check if the sensor has already been initialised */
    ret = bmi270_reg_read(ctx, BMI270_REG_INTERNAL_STATUS, &values, sizeof(values)); 
    if (ret != 0){
        LOG_INF("Failed to check sensor status");
        return false;
    }
    if ((values & BIT(0))){
        return true;
    }else{
        /* Wait for 200us for SPI to be fully configured */
        k_usleep(200);

        /* Check sensor ID */
        ret = bmi270_reg_read(ctx, BMI270_REG_CHIP_ID, &values, sizeof(values)); 
        if (ret != 0){
            LOG_INF("Failed to read sensor ID"); 
            return false; 
        }

        if (values != CHIP_ID_BMI270){
            return false; 
        }

        /* Disable advanced power save mode */
        tx_buf = BMI270_FAST_POWER_UP_DIS | BMI270_FIFO_SELF_WAKE_UP_ON | BMI270_ADV_POWER_SAVE_DIS; 
        ret = bmi270_reg_write_with_delay(ctx, BMI270_REG_PWR_CONF, &tx_buf, sizeof(tx_buf), 450); 
        if (ret != 0){
            LOG_INF("Failed to turn off advanced power save mode");
            return false; 
        }

        LOG_INF("Disabled advanced power save mode");

        /* Preapre to load configuration file */
        tx_buf = 0x00;
        ret = bmi270_reg_write(ctx, BMI270_REG_INIT_CTRL, &tx_buf, sizeof(tx_buf)); 
        if (ret != 0){
            LOG_INF("Failed to prepare configuration file loading");
            return false;
        }

        LOG_INF("Prepared to load configuration file");

        /* Upload configuration file */
        ret = write_config_file(ctx); 
        if (ret != 0){
            LOG_INF("Failed to upload configuration file");
            return false;
        }

        LOG_INF("Configuration file uploaded"); 

        /* Complete config load */
        tx_buf = 0x01;
        ret = bmi270_reg_write_with_delay(ctx, BMI270_REG_INIT_CTRL, &tx_buf, sizeof(tx_buf), 30000); 
        if (ret != 0){
            LOG_INF("Failed to complete config load");
            return false;
        }

        LOG_INF("Completed config load");

        /* Check sensor status */
        ret = bmi270_reg_read(ctx, BMI270_REG_INTERNAL_STATUS, &values, sizeof(values)); 
        if (ret != 0){
            LOG_INF("Failed to check sensor status");
            return false;
        }
        /* Successful init requires bit0 to be set */
        if ((values & BIT(0)) != 1){
            LOG_INF("Initialisation Failed! Status: 0x%02X", values);
            return false;
        }

        LOG_INF("BMI270 initialised"); 
        return true; 
    }
}

/**
 * @brief Configure FIFO settings
 * 
 * Configure BMI270 FIFO downsampling, watermark and content
 * 
 * @param ctx A pointer to a BMI270 sensor context
 * @param watermark FIFO watermark level (Max: 8191)
 * @param config A pointer to a BMI270 FIFO configuration structure 
 * 
 * @return 0 if successful
 */
int bmi270_conf_fifo(BMI270_Context *ctx, uint16_t watermark, bmi270_fifo_config_t *config){
    int ret = 0;
    /* Set FIFO watermark */
    ret = bmi270_conf_fifo_watermark(ctx, watermark);

    /* Set gyr and acc downsampling rates for FIFO */
    uint8_t fifo_downs = config->gyr_fifo_downs | 
                        (config->gyr_filter << 3) | 
                        (config->acc_fifo_downs << 4) |
                        (config->acc_filter << 7);
    ret = bmi270_reg_write_with_delay(ctx, BMI270_REG_FIFO_DOWNS, &fifo_downs, sizeof(fifo_downs), 20); 
    if (ret != 0){
        LOG_ERR("Failed to configure FIFO downsampling @0x%02X", BMI270_REG_FIFO_DOWNS);
        return ret; 
    }

    /* Set FIFO frame content configuration */
    uint8_t fifo_config[2];
    fifo_config[0] = config->fifo_stop_on_full | (config->ret_sensor_time << 1);
    fifo_config[1] = (config->fifo_header_en << 4) | 
                        (config->fifo_aux_en << 5) | 
                        (config->fifo_acc_en << 6) | 
                        (config->fifo_gyr_en << 7); 
    ret = bmi270_reg_write_with_delay(ctx, BMI270_REG_FIFO_CONFIG_0, fifo_config, sizeof(fifo_config), 20); 
    if (ret != 0){
        LOG_ERR("Failed to configure FIFO frame content @0x%02X", BMI270_REG_FIFO_CONFIG_0);
        return ret;
    }
    
    LOG_INF("BMI270 FIFO configuration successful");
    return 0; 
}

/**
 * @brief Configure accelerometer
 * 
 * Set accelerometer ODR, measurement range, oversampling, average and measurement mode
 * 
 * @param ctx A pointer to a BMI270 context
 * @param config A pointer to a BMI270 acceleration configuration structure
 * 
 * @return 0 if successful
 */
int bmi270_conf_acc(BMI270_Context *ctx, bmi270_acc_config_t *config){
    int ret = 0;
    uint8_t acc_conf[2];

    acc_conf[0] = (config->acc_odr | 
                    (config->acc_bwp << 4) |
                    (config->low_power_enable << 7));
    acc_conf[1] = config->acc_range;
    ret = bmi270_reg_write_with_delay(ctx, BMI270_REG_ACC_CONF, acc_conf, 2, 20);
    if (ret != 0){
        LOG_ERR("Failed to configure accelerometer @0x%02X", BMI270_REG_ACC_CONF);
        return ret;
    }
    LOG_INF("BMI270 accelerometer configuration successful"); 
    return 0; 
}

/**
 * @brief Configure gyroscope
 * 
 * Set gyroscope ODR, measurement range, oversampling and measurement mode
 * 
 * @param ctx A pointer to a BMI270 context
 * @param config A pointer to a BMI270 gyroscope configuration structure
 * 
 * @return 0 if successful
 */
int bmi270_conf_gyr(BMI270_Context *ctx, bmi270_gyr_config_t *config){
    int ret = 0;
    uint8_t gyr_conf[2];

    gyr_conf[0] = (config->gyr_odr |
                    (config->gyr_bwp << 4) | 
                    (config->low_power_enable << 7));
    gyr_conf[1] = config->gyr_range;
    ret = bmi270_reg_write_with_delay(ctx, BMI270_REG_GYR_CONF, gyr_conf, 2, 20);
    if (ret != 0){
        LOG_ERR("Failed to configure gyroscope @0x%02X", BMI270_REG_GYR_CONF);
        return ret;
    }
    LOG_INF("BMI270 gyroscope configuration successful");
    return 0; 
}

/**
 * @brief Set BMI270 to operation mode
 * 
 * Set BMI270 to normal, low-power or suspend mode, choose sensors to be enabled
 * 
 * @note In suspend mode, all sensors are turned off. In low-power mode, 
 * 
 * @param ctx A pointer to a BMI270 sensor context
 * @param mode Operation mode 
 * @param acc_enable Enable accelerometer
 * @param gyr_enable Enable gyroscope
 * 
 * @return 0 if successful
 */
void bmi270_set_mode(BMI270_Context *ctx, BMI270_PowerMode mode, bool acc_enable, bool gyr_enable){
    /* Enable sensors */
    if (acc_enable && gyr_enable){
        bmi270_enable_sensor(ctx, 1, 1, 0, 0);
    }
    if (acc_enable && !gyr_enable){
        bmi270_enable_sensor(ctx, 1, 0, 0, 0);
    }

    uint8_t value;
    uint8_t pwr_ctrl_value;

    /* Configure power mode */
    switch (mode){
    case BMI270_PERFORMANCE_MODE:
        /* Disable advanced power save mode */
        value = 0x02;
        bmi270_reg_write(ctx, BMI270_REG_PWR_CONF, &value, 1);
        /* Configure acc and gyr to performance mode - (typ.) 970uA */
        bmi270_conf_pwr(ctx, &bmi270_performance_mode); 
        LOG_INF("BMI270 configured to performance mode");
        break;
    case BMI270_NORMAL_MODE:
        /* Disable advanced power save mode */
        value = 0x02;
        bmi270_reg_write(ctx, BMI270_REG_PWR_CONF, &value, 1); 
        /* Configure acc and gyr to normal mode - (typ.) 685uA */
        bmi270_conf_pwr(ctx, &bmi270_normal_mode); 
        LOG_INF("BMI270 configured to normal mode");
        break;
    case BMI270_LOW_POWER_MODE:
        /* Disable temperature and aux sensor */
        pwr_ctrl_value = 0x06; 
        bmi270_reg_write(ctx, BMI270_REG_PWR_CTRL, &pwr_ctrl_value, 1); 
        /* Enable advanced power save mode */
        value = 0x03;
        bmi270_reg_write(ctx, BMI270_REG_PWR_CONF, &value, 1); 
        /* Configure acc and gyr to low power mode - (typ.) 420uA */
        bmi270_conf_pwr(ctx, &bmi270_low_power_mode);
        LOG_INF("BMI270 configured to low power mode: gyro and acc enabled");
        break;
    case BMI270_SUSPEND_MODE:
        /* Check if all sensors are disabled */
        if (acc_enable || gyr_enable){
            LOG_ERR("Disable all sensors to enter suspend mode");
            break;
        }
        /* Enable advanced power save mode */
        value = 0x03;
        bmi270_reg_write(ctx, BMI270_REG_PWR_CONF, &value, 1); 
        /* Disable all sensors - (typ.) 3.5uA */
        bmi270_enable_sensor(ctx, 0, 0, 0, 0);
        LOG_INF("BMI270 configured to suspend mode: all sensors disabled"); 
        break;
    default:
        break;
    }
}

/**
 * @brief Read IMU values
 * 
 * Read raw values from IMU and convert them to physical values
 * 
 * @param ctx A pointer to a BMI270 sensor context
 * @param value An array to save the sensor values
 * @param acc_range Measurement range for acc
 * @param gyr_range Measurement range for gyr
 * 
 * @retval 0 if successful, err otherwise
 */
int bmi270_read_imu(BMI270_Context *ctx, BMI270_IMU_Value *value, uint8_t acc_range, uint8_t gyr_range){
    int ret = 0;
    uint8_t sensor_values[12];
    uint8_t acc_range_g; 
    uint16_t gyr_range_r;
    uint8_t factor_zx; 
    uint8_t factor_zx_page = 0; 

    switch (acc_range){
    case BMI270_ACC_RANGE_2G:
        acc_range_g = 2; 
        break;
    case BMI270_ACC_RANGE_4G:
        acc_range_g = 4;
        break;
    case BMI270_ACC_RANGE_8G:
        acc_range_g = 8;
        break;
    case BMI270_ACC_RANGE_16G:
        acc_range_g = 16;
        break;
    default:
        acc_range_g = 0; 
        break;
    }

    switch (gyr_range){
    case BMI270_GYR_RANGE_125:
        gyr_range_r = 125; 
        break;
    case BMI270_GYR_RANGE_250:
        gyr_range_r = 250;
        break;
    case BMI270_GYR_RANGE_500:
        gyr_range_r = 500;
        break;
    case BMI270_GYR_RANGE_1000:
        gyr_range_r = 1000;
        break;
    case BMI270_GYR_RANGE_2000:
        gyr_range_r = 2000;
        break;
    default:
        gyr_range_r = 0; 
        break;
    }

    /* Read sensor values */
    ret = bmi270_reg_read(ctx, BMI270_REG_ACC_X_LSB, sensor_values, sizeof(sensor_values)); 
    /* Read calibration factor on page 0 for gyro x - sign extended 7-bit */
    ret = bmi270_reg_write(ctx, BMI270_REG_FEAT_PAGE, &factor_zx_page, sizeof(factor_zx_page)); 
    ret = bmi270_reg_read(ctx, 0x3C, &factor_zx, 1); 
    if (factor_zx & BIT(6)){
        factor_zx |= 0x80;
    }else{
        factor_zx &= 0x7F; 
    }

    if (ret == 0){
        bmi270_acc_convert_raw(&value->accel.x, (int16_t)(sensor_values[0] | (sensor_values[1] << 8)), acc_range_g);
        bmi270_acc_convert_raw(&value->accel.y, (int16_t)(sensor_values[2] | (sensor_values[3] << 8)), acc_range_g);
        bmi270_acc_convert_raw(&value->accel.z, (int16_t)(sensor_values[4] | (sensor_values[5] << 8)), acc_range_g); 

        bmi270_gyr_convert_raw(&value->gyro.x, 
            ((int16_t)(sensor_values[6] | (sensor_values[7] << 8)) - (int8_t)factor_zx * ((int16_t)(sensor_values[10] | (sensor_values[11] << 8)))/512), 
            gyr_range_r);
        bmi270_gyr_convert_raw(&value->gyro.y, (int16_t)(sensor_values[8] | (sensor_values[9] << 8)), gyr_range_r);
        bmi270_gyr_convert_raw(&value->gyro.z, (int16_t)(sensor_values[10] | (sensor_values[11] << 8)), gyr_range_r); 
    }else{
        LOG_ERR("Failed to read sensor data");
    }

    return ret; 
}

int bmi270_conf_no_motion(BMI270_Context *ctx, bmi270_no_motion_config_t *config){
    int ret = 0;
    uint16_t duration, threshold;
    uint8_t nomo_param[4];
    uint8_t nomo_page = 2; 
    uint8_t default_page = 0; 

    // Duration is in 20ms steps
    duration = config->duration;
    if (duration > 0x1FFF) { // 13-bit value
        LOG_ERR("No-motion duration exceeds maximum");
        return -1; 
    }

    // The threshold value passed in the struct should be the raw register value.
    // The datasheet default is 0x90 for 70mg.
    threshold = config->threshold; 
    if (threshold > 0x7FF){ // 11-bit value
        LOG_ERR("No-motion threshold exceeds maximum");
        return -1; 
    }

    /* Change the page number to page 2 for no motion detection */
    ret = bmi270_reg_write(ctx, BMI270_REG_FEAT_PAGE, &nomo_page, sizeof(nomo_page)); 
    if (ret != 0) {
        LOG_ERR("Failed to switch to feature page 2");
        return ret;
    }
    k_usleep(BMI270_INTER_WRITE_DELAY_US); 

    /* Prepare the no motion detection parameters */
    nomo_param[0] = duration & 0xFF; 
    nomo_param[1] = ((duration >> 8) & 0x1F) | 
                    config->select_z << 7 | 
                    config->select_y << 6 | 
                    config->select_x << 5;
    nomo_param[2] = threshold & 0xFF;
    nomo_param[3] = ((threshold >> 8) & 0x07) | (0x06 << 3) | config->enable << 7; 

    ret = bmi270_reg_write(ctx, 0x30, nomo_param, sizeof(nomo_param)); 
    if (ret != 0){
        LOG_ERR("Failed to configure no-motion detection parameters");
    }

    k_usleep(BMI270_INTER_WRITE_DELAY_US);
    ret = bmi270_reg_write(ctx, BMI270_REG_FEAT_PAGE, &default_page, sizeof(default_page));
    if (ret != 0) {
        LOG_ERR("Failed to reset feature page to 0");
        return ret;
    }

    return 0; 
}

int bmi270_conf_any_motion(BMI270_Context *ctx, bmi270_no_motion_config_t *config){
    int ret = 0;
    uint16_t duration, threshold;
    uint8_t nomo_param[4];
    uint8_t anymo_page = 1; 
    uint8_t default_page = 0; 

    // Duration is in 20ms steps
    duration = config->duration;
    if (duration > 0x1FFF) { // 13-bit value
        LOG_ERR("No-motion duration exceeds maximum");
        return -1; 
    }

    // The threshold value passed in the struct should be the raw register value.
    // The datasheet default is 0x90 for 70mg.
    threshold = config->threshold; 
    if (threshold > 0x7FF){ // 11-bit value
        LOG_ERR("Any motion threshold exceeds maximum");
        return -1; 
    }

    /* Change the page number to page 2 for no motion detection */
    ret = bmi270_reg_write(ctx, BMI270_REG_FEAT_PAGE, &anymo_page, sizeof(anymo_page)); 
    if (ret != 0) {
        LOG_ERR("Failed to switch to feature page 1");
        return ret;
    }
    k_usleep(BMI270_INTER_WRITE_DELAY_US); 

    /* Prepare the no motion detection parameters */
    nomo_param[0] = duration & 0xFF; 
    nomo_param[1] = ((duration >> 8) & 0x1F) | 
                    config->select_z << 7 | 
                    config->select_y << 6 | 
                    config->select_x << 5;
    nomo_param[2] = threshold & 0xFF;
    nomo_param[3] = ((threshold >> 8) & 0x07) | (0x07 << 3) | config->enable << 7; 

    ret = bmi270_reg_write(ctx, 0x3C, nomo_param, sizeof(nomo_param)); 
    if (ret != 0){
        LOG_ERR("Failed to configure any motion detection parameters");
    }

    k_usleep(BMI270_INTER_WRITE_DELAY_US);
    ret = bmi270_reg_write(ctx, BMI270_REG_FEAT_PAGE, &default_page, sizeof(default_page));
    if (ret != 0) {
        LOG_ERR("Failed to reset feature page to 0");
        return ret;
    }

    return 0; 
}

/**
 * @brief Configure interrupt electrical behaviour and type 
 * 
 * @param ctx A pointer to a BMI270 sensor context
 * @param config An interrupt configuration (electrical behaviour)
 * @param pin A number between 1 and 2
 * 
 * @retval 0 if successful, err otherwise
 */
int bmi270_conf_interrupt(BMI270_Context *ctx, bmi270_interrupt_config_t *config, uint8_t pin){
    int ret = 0;
    uint8_t int_type_data; 
    uint8_t target_reg; 

    /* Configurations for electrical behaviour */
    uint8_t elec_int_config = (config->input_en << 4) |
                        (config->output_en << 3) |
                        (config->odb << 2) |
                        (config->lvl << 1);

    /* Configuration for latch mode */
    uint8_t int_latch = config->int_latch;
    ret = bmi270_reg_write(ctx, BMI270_REG_INT_LATCH, &int_latch, 1);
    if (ret != 0){
        LOG_ERR("Failed to configure interrupt latch mode");
        return ret;
    }
    LOG_DBG("Latch mode configured");

    /* Feature interrupt or data interrupt */
    bool type_int = config->use_data;
    if (type_int == 0){
        // If use feature interrupt: configuration register is different for INT1 and INT2, configuration data is the same
        int_type_data = config->interrupt_type.feature_int;
        if (pin == 1){
            target_reg = BMI270_REG_INT1_MAP_FEAT;
        }else if (pin == 2){
            target_reg = BMI270_REG_INT2_MAP_FEAT;
        }else{
            LOG_ERR("Invalid INT pin selection");
            return -1; 
        }
    }else if (type_int == 1){
        // If use data interrupt: configuration register is the same for INT1 and INT2, configuration data is different
        target_reg = BMI270_REG_INT_MAP_DATA; 
        int_type_data = config->interrupt_type.data_int; 
        if (pin == 1){
            int_type_data = int_type_data; 
        }else if (pin == 2){
            int_type_data = int_type_data << 4; 
        }else{
            LOG_ERR("Invalid INT pin selection");
            return -1; 
        }
    }else{
        LOG_ERR("Invalid INT type: choose between 0 (feature) and 1 (data)");
        return -1; 
    }
    
    switch (pin){
    case 1:
        ret = bmi270_reg_write(ctx, BMI270_REG_INT1_IO_CTRL, &elec_int_config, 1);
        if (ret != 0){
            LOG_ERR("Failed to configure interrupt %d's behaviour", pin);
            return ret; 
        }
        ret = bmi270_reg_write(ctx, target_reg, &int_type_data, 1); 
        if (ret != 0){
            LOG_ERR("Failed to configure interrupt %d @0x%02X", pin, target_reg);
            return ret; 
        }
        LOG_DBG("Interrupt 1 configured"); 
        break;
    case 2:
        ret = bmi270_reg_write(ctx, BMI270_REG_INT2_IO_CTRL, &elec_int_config, 1); 
        if (ret != 0){
            LOG_ERR("Failed to configure interrupt %d's behaviour", pin);
            return ret; 
        }
        ret = bmi270_reg_write(ctx, target_reg, &int_type_data, 1);
        if (ret != 0){
            LOG_ERR("Failed to configure interrupt %d @0x%02X", pin, target_reg);
            return ret; 
        }
        LOG_DBG("Interrupt 2 configured"); 
        break;
    default:
        LOG_ERR("Select interrupt 1 or interrupt 2"); 
        break;
    }
    return 0; 
}

uint16_t bmi270_read_int_status(BMI270_Context *ctx){
    int ret = 0;
    uint8_t int_status[2];

    ret = bmi270_reg_read(ctx, BMI270_REG_INT_STATUS_0, int_status, sizeof(int_status));
    if (ret != 0){
        LOG_ERR("Failed to read interrupt status");
    }
    LOG_INF("The interrupt status is: 0x%02X\t0x%02X", int_status[0], int_status[1]); 

    uint16_t ret_status = (int_status[0] << 8) | (int_status[1]); 
    
    return ret_status;
}

uint8_t bmi270_read_fifo_length(BMI270_Context *ctx){
    int ret = 0;

    uint8_t buf[2];
    ret = bmi270_reg_read(ctx, BMI270_REG_FIFO_LENGTH_0, buf, sizeof(buf));
    if (ret != 0){
        LOG_ERR("Failed to read FIFO length");
    }

    uint8_t fifo_length;
    fifo_length = (buf[1] << 8) | buf[0];

    return fifo_length; 
}

void bmi270_read_no_motion_config(BMI270_Context *ctx){
    int ret = 0;

    uint8_t nomo_page = 0; 
    /* Change the page number to page 2 for no motion detection */
    ret = bmi270_reg_write(ctx, BMI270_REG_FEAT_PAGE, &nomo_page, sizeof(nomo_page)); 
    if (ret != 0){
        LOG_ERR("Failed to change page number");
    }
    
    uint8_t page; 
    ret = bmi270_reg_read(ctx, BMI270_REG_FEAT_PAGE, &page, sizeof(page)); 
    LOG_DBG("Page number is %d", page); 

    uint8_t buf[4];
    ret = bmi270_reg_read(ctx, 0x5e, buf, sizeof(buf)); 
    if (ret != 0){
        LOG_ERR("Failed to read feature register"); 
    }
    LOG_DBG("0x%02x 0x%02x 0x%02x 0x%02x", buf[0], buf[1], buf[2], buf[3]); 
}