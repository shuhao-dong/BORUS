## boards/nordic/torus53/Kconfig
```kconfig
# Torus53 NRF5340 board configuration

# Copyright (c) 2021 Nordic Semiconductor ASA
# SPDX-License-Identifier: Apache-2.0

config TORUS53_INIT_PRIORITY
	int "Init priority"
	default 79
	help
	  Initialization priority of the Torus:53.

if BOARD_TORUS53_NRF5340_CPUAPP || BOARD_TORUS53_NRF5340_CPUAPP_NS

config DOMAIN_CPUNET_BOARD
	string
	default "torus53/nrf5340/cpunet"
	help
	  The board which will be used for CPUNET domain when creating a multi
	  image application where one or more images should be located on
	  another board. For example hci_ipc on the nRF5340_cpunet for
	  Bluetooth applications.

endif # BOARD_TORUS53_NRF5340_CPUAPP || BOARD_TORUS53_NRF5340_CPUAPP_NS

if BOARD_TORUS53_NRF5340_CPUNET

config DOMAIN_CPUAPP_BOARD
	string
	default "torus53/nrf5340/cpuapp"
	help
	  The board which will be used for CPUAPP domain when creating a multi
	  image application where one or more images should be located on
	  another board.

endif # BOARD_TORUS53_NRF5340_CPUNET
```

## build/Kconfig/Kconfig.shield.defconfig
```kconfig
osource "/Users/gw23523/Documents/nordic/my_boards/boards/shields/*/Kconfig.defconfig"
osource "/opt/nordic/ncs/v2.7.0/nrf/boards/shields/*/Kconfig.defconfig"
```

## build/mcuboot/Kconfig/Kconfig.shield
```kconfig
osource "/Users/gw23523/Documents/nordic/my_boards/boards/shields/*/Kconfig.shield"
osource "/opt/nordic/ncs/v2.7.0/nrf/boards/shields/*/Kconfig.shield"
```
